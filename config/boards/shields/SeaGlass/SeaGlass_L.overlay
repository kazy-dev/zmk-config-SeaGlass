#include "SeaGlass.dtsi"
#include <behaviors/battery_history_request.dtsi>

&kscan_matrix {
        col-gpios
            = <&gpio0 28 GPIO_ACTIVE_HIGH>
            , <&gpio1 1 GPIO_ACTIVE_HIGH>
            , <&gpio0 29 GPIO_ACTIVE_HIGH>
            , <&gpio0 9 GPIO_ACTIVE_HIGH>
            , <&gpio0 4 GPIO_ACTIVE_HIGH>
            ;
};

&left_encoder {
    status = "okay";
};


&right_encoder {
    status = "okay";
};
